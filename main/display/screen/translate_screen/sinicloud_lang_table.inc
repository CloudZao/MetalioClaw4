    {0, "zh", "中文"},
    {1, "en", "英语"},
    {2, "ja", "日语"},
    {3, "ko", "韩语"},
    {4, "yue", "粤语"},
    {5, "ru", "俄语"},
    {6, "ar", "阿拉伯语"},
    {7, "es", "西班牙语"},
    {8, "it", "意大利语"},
    {9, "vi", "越南语"},
    {10, "fr", "法语"},
    {11, "de", "德语"},
    {12, "pt", "葡萄牙语"},
    {13, "tr", "土耳其语"},
    {14, "pl", "波兰语"},
    {15, "ca", "加泰罗尼亚语"},
    {16, "nl", "荷兰语"},
    {17, "sv", "瑞典语"},
    {18, "id", "印尼语"},
    {19, "hi", "印地语"},
    {20, "fi", "芬兰语"},
    {21, "he", "希伯来语"},
    {22, "uk", "乌克兰语"},
    {23, "el", "希腊语"},
    {24, "ml", "马来语"},
    {25, "cs", "捷克语"},
    {26, "ro", "罗马尼亚语"},
    {27, "da", "丹麦语"},
    {28, "hu", "匈牙利语"},
    {29, "ta", "泰米尔语"},
    {30, "no", "挪威语"},
    {31, "th", "泰语"},
    {32, "ur", "乌尔都语"},
    {33, "hr", "克罗地亚语"},
    {34, "bg", "保加利亚语"},
    {35, "lt", "立陶宛语"},
    {36, "la", "拉丁语"},
    {37, "mi", "毛利语"},
    {38, "ml", "马拉雅拉姆语"},
    {39, "cy", "威尔士语"},
    {40, "sk", "斯洛伐克语"},
    {41, "te", "泰卢固语"},
    {42, "fa", "波斯语"},
    {43, "lv", "拉脱维亚语"},
    {44, "bn", "孟加拉语"},
    {45, "sr", "塞尔维亚语"},
    {46, "az", "阿塞拜疆语"},
    {47, "sl", "斯洛文尼亚语"},
    {48, "kn", "埃纳德语"},
    {49, "et", "爱沙尼亚语"},
    {50, "mk", "马其顿语"},
    {51, "br", "布雷顿语"},
    {52, "eu", "巴斯克语"},
    {53, "is", "冰岛语"},
    {54, "hy", "亚美尼亚语"},
    {55, "ne", "尼泊尔语"},
    {56, "mn", "蒙古语"},
    {57, "bs", "波斯尼亚语"},
    {58, "kk", "哈萨克语"},
    {59, "sq", "阿尔巴尼亚语"},
    {60, "sw", "斯瓦希里语"},
    {61, "gl", "加利西亚语"},
    {62, "mr", "马拉地语"},
    {63, "pa", "旁遮普语"},
    {64, "si", "僧伽罗语"},
    {65, "km", "高棉语"},
    {66, "sn", "绍纳语"},
    {67, "yo", "约鲁巴语"},
    {68, "so", "索马里语"},
    {69, "af", "南非语"},
    {70, "oc", "奥克西坦语"},
    {71, "ka", "格鲁吉亚语"},
    {72, "be", "白俄罗斯语"},
    {73, "tg", "塔吉克语"},
    {74, "sd", "信德语"},
    {75, "gu", "古吉拉特语"},
    {76, "am", "阿姆哈拉语"},
    {77, "yi", "意第绪语"},
    {78, "lo", "老挝语"},
    {79, "uz", "乌兹别克语"},
    {80, "fo", "法罗语"},
    {81, "ht", "海地语"},
    {82, "ps", "普什图语"},
    {83, "tk", "土库曼语"},
    {84, "nn", "尼诺斯克语"},
    {85, "mt", "马耳他语"},
    {86, "sa", "梵语"},
    {87, "lb", "卢森堡语"},
    {88, "my", "缅甸语"},
    {89, "bo", "藏语"},
    {90, "tl", "菲律宾语"},
    {91, "mg", "马达加斯加语"},
    {92, "as", "阿萨姆语"},
    {93, "tt", "塔塔尔语"},
    {94, "haw", "夏威夷语"},
    {95, "ln", "林加拉语"},
    {96, "ha", "豪萨语"},
    {97, "ba", "巴什基尔语"},
    {98, "jw", "爪哇语"},
    {99, "su", "巽他语"},
